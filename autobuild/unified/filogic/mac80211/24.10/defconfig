## autobuild/unified/filogic/mac80211/24.10/defconfig
```kconfig
CONFIG_TARGET_DEVICE_mediatek_filogic_DEVICE_comfast_cf-e393ax=y
CONFIG_TARGET_DEVICE_mediatek_filogic_DEVICE_comfast_cf-e593ax=y
# CONFIG_TARGET_DEVICE_mediatek_filogic_DEVICE_mediatek_mt7981-rfb is not set
# CONFIG_TARGET_DEVICE_mediatek_filogic_DEVICE_mediatek_mt7986a-rfb-nand is not set
# CONFIG_TARGET_DEVICE_mediatek_filogic_DEVICE_mediatek_mt7988a-rfb is not set
# CONFIG_TARGET_DEVICE_mediatek_filogic_DEVICE_mediatek_mt7986b-rfb is not set
CONFIG_TARGET_DEVICE_mediatek_filogic_DEVICE_yuncore_ax835=y
CONFIG_KERNEL_PROFILING=y
CONFIG_KERNEL_BPF_EVENTS=y
CONFIG_DEVEL=y
CONFIG_IB=y
CONFIG_IMAGEOPT=y
CONFIG_VERSIONOPT=y
CONFIG_BUSYBOX_CONFIG_TELNET=y
CONFIG_BUSYBOX_CONFIG_TELNETD=y
CONFIG_BUSYBOX_CONFIG_FEATURE_TELNETD_STANDALONE=y
CONFIG_PACKAGE_ca-certificates=m
CONFIG_PACKAGE_dnsmasq-full=m
CONFIG_PACKAGE_dnsmasq_full_ipset=y
CONFIG_PACKAGE_netjson-monitoring=m
CONFIG_PACKAGE_openwisp-config=m
CONFIG_PACKAGE_openwisp-monitoring=m
CONFIG_PACKAGE_flex=m
CONFIG_PACKAGE_mt76-test=y
CONFIG_PACKAGE_perf=y
# CONFIG_PACKAGE_airoha-en8811h-firmware is not set
# CONFIG_PACKAGE_as21xxx-firmware is not set
CONFIG_PACKAGE_eip197-mini-firmware=y
# CONFIG_PACKAGE_mt7986-wo-firmware is not set
# CONFIG_PACKAGE_kmod-crypto-hw-safexcel is not set
CONFIG_PACKAGE_kmod-fs-ksmbd=y
CONFIG_PACKAGE_kmod-br-netfilter=y
CONFIG_PACKAGE_kmod-ipt-ipset=m
CONFIG_PACKAGE_kmod-nf-conntrack-netlink=m
CONFIG_PACKAGE_kmod-mt798x-2p5g-phy=y
# CONFIG_PACKAGE_kmod-phy-airoha-en8811h is not set
# CONFIG_PACKAGE_kmod-phy-aquantia is not set
# CONFIG_PACKAGE_kmod-phy-marvell is not set
# CONFIG_PACKAGE_kmod-phy-marvell-10g is not set
CONFIG_PACKAGE_kmod-phylink=y
# CONFIG_PACKAGE_kmod-sfp is not set
# CONFIG_PACKAGE_kmod-eeprom-at24 is not set
CONFIG_PACKAGE_kmod-mtd-rw=m
CONFIG_PACKAGE_kmod-usb3=y
CONFIG_PACKAGE_CFG80211_TESTMODE=y
CONFIG_PACKAGE_kmod-mt7915-firmware=y
# CONFIG_PACKAGE_kmod-mt7986-firmware is not set
# CONFIG_PACKAGE_kmod-mt7996-firmware is not set
# CONFIG_PACKAGE_kmod-mt7996e is not set
CONFIG_PACKAGE_lua-cjson=m
CONFIG_PACKAGE_luafilesystem=m
CONFIG_PACKAGE_libgdbm=m
CONFIG_PACKAGE_libnetfilter-conntrack=m
CONFIG_PACKAGE_libnettle=m
CONFIG_PACKAGE_libnl-genl=y
CONFIG_PACKAGE_libpcre2=m
CONFIG_PACKAGE_libuci-lua=m
CONFIG_PACKAGE_luci-ssl=m
CONFIG_PACKAGE_luci-app-advanced=m
# CONFIG_PACKAGE_luci-app-ksmbd is not set
CONFIG_PACKAGE_luci-app-omcproxy=y
CONFIG_PACKAGE_luci-app-pbr=m
CONFIG_PACKAGE_luci-theme-openwrt-2020=m
CONFIG_PACKAGE_atenl=y
CONFIG_PACKAGE_netfilter-flowtable=y
CONFIG_PACKAGE_kmod-crypto-eip-ddk=y
CONFIG_PACKAGE_kmod-pce=y
CONFIG_PACKAGE_curl=m
# CONFIG_PACKAGE_ksmbd-server is not set
CONFIG_PACKAGE_iptables-mod-conntrack-extra=y
CONFIG_PACKAGE_iptables-mod-extra=y
CONFIG_PACKAGE_avahi-daemon-service-http=m
CONFIG_PACKAGE_avahi-daemon-service-ssh=m
CONFIG_PACKAGE_avahi-utils=m
CONFIG_PACKAGE_wsdd2=y
CONFIG_PACKAGE_nmap=m
CONFIG_PACKAGE_pbr=m
CONFIG_PACKAGE_strongswan=y
CONFIG_PACKAGE_strongswan-default=y
CONFIG_PACKAGE_strongswan-mod-kdf=y
CONFIG_PACKAGE_afcd=y
CONFIG_PACKAGE_hostapd-utils=y
CONFIG_PACKAGE_wpa-cli=y
CONFIG_WPA_MSG_MIN_PRIORITY=2
CONFIG_PACKAGE_arp-scan=m
CONFIG_PACKAGE_arp-scan-database=m
CONFIG_PACKAGE_fping=m
CONFIG_PACKAGE_iftop=m
CONFIG_PACKAGE_iperf3=y
CONFIG_PACKAGE_ipset=m
# CONFIG_PACKAGE_iw is not set
CONFIG_PACKAGE_iw-full=y
CONFIG_PACKAGE_libipset=m
CONFIG_PACKAGE_smp_util=y
CONFIG_PACKAGE_tcpdump-mini=m
CONFIG_PACKAGE_blkid=y
CONFIG_PACKAGE_nano=m
CONFIG_PACKAGE_px5g-mbedtls=m
CONFIG_PACKAGE_e2fsprogs=y
CONFIG_PACKAGE_f2fsck=y
CONFIG_PACKAGE_mkf2fs=y
CONFIG_PACKAGE_irqbalance=m
```
